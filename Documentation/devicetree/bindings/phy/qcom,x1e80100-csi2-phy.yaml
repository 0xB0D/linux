## Documentation/devicetree/bindings/phy/qcom,x1e80100-csi2-phy.yaml
```yaml
# SPDX-License-Identifier: (GPL-2.0 OR BSD-2-Clause)
%YAML 1.2
---
$id: http://devicetree.org/schemas/phy/qcom,x1e80100-csi2-phy.yaml#
$schema: http://devicetree.org/meta-schemas/core.yaml#

title: Qualcomm SoC CSI2 PHY

maintainers:
  - Bryan O'Donoghue <bod@kernel.org>

description:
  Qualcomm MIPI CSI2 C-PHY/D-PHY combination PHY. Connects MIPI CSI2 sensors
  to Qualcomm's Camera CSI Decoder. The PHY supports both C-PHY and D-PHY
  modes.

properties:
  compatible:
    const: qcom,x1e80100-csi2-phy

  reg:
    maxItems: 1

  "#phy-cells":
    const: 1
    description:
      The single cell specifies the PHY operating mode.

  clocks:
    maxItems: 2

  clock-names:
    items:
      - const: core
      - const: timer

  interrupts:
    maxItems: 1

  operating-points-v2: true

  power-domains:
    items:
      - description: Titan Top GDSC - Titan ISP Block, Global Distributed Switch Controller.
      - description: MMCX voltage rail
      - description: MXC or MXA voltage rail

  power-domain-names:
    items:
      - const: top
      - const: mmcx
      - const: mx

  vdda-0p8-supply:
    description: Phandle to a 0.8V regulator supply to a PHY.

  vdda-1p2-supply:
    description: Phandle to 1.2V regulator supply to a PHY.

  ports:
    $ref: /schemas/graph.yaml#/properties/ports

    properties:
      port@0:
        $ref: /schemas/graph.yaml#/$defs/port-base
        description: Sensor input. Always present.
        unevaluatedProperties: false

        patternProperties:
          "^endpoint(@[0-9a-f]+)?$":
            $ref: /schemas/media/video-interfaces.yaml#
            unevaluatedProperties: false
            properties:
              data-lanes:
                minItems: 1
                maxItems: 4
              clock-lanes:
                maxItems: 1
              remote-endpoint: true
            required:
              - data-lanes
              - remote-endpoint

      port@1:
        $ref: /schemas/graph.yaml#/$defs/port-base
        description:
          Second sensor input. When present, indicates DPHY split mode.
        unevaluatedProperties: false

        patternProperties:
          "^endpoint(@[0-9a-f]+)?$":
            $ref: /schemas/media/video-interfaces.yaml#
            unevaluatedProperties: false
            properties:
              data-lanes:
                maxItems: 1
              clock-lanes:
                maxItems: 1
              remote-endpoint: true
            required:
              - data-lanes
              - clock-lanes
              - remote-endpoint

      port@2:
        $ref: /schemas/graph.yaml#/$defs/port-base
        description: Output to CAMSS controller.
        unevaluatedProperties: false

        patternProperties:
          "^endpoint(@[0-9a-f]+)?$":
            $ref: /schemas/graph.yaml#/$defs/endpoint-base
            unevaluatedProperties: false
            properties:
              remote-endpoint: true
            required:
              - remote-endpoint

    required:
      - port@0
      - port@2

required:
  - compatible
  - reg
  - "#phy-cells"
  - clocks
  - clock-names
  - interrupts
  - operating-points-v2
  - power-domains
  - power-domain-names
  - vdda-0p8-supply
  - vdda-1p2-supply
  - ports

additionalProperties: false

examples:
  - |
    #include <dt-bindings/interrupt-controller/arm-gic.h>
    #include <dt-bindings/clock/qcom,x1e80100-camcc.h>
    #include <dt-bindings/clock/qcom,x1e80100-gcc.h>
    #include <dt-bindings/power/qcom,rpmhpd.h>

    csiphy4: phy@ace4000 {
        compatible = "qcom,x1e80100-csi2-phy";
        reg = <0x0ace4000 0x2000>;
        #phy-cells = <1>;

        clocks = <&camcc CAM_CC_CSIPHY0_CLK>,
                 <&camcc CAM_CC_CSI0PHYTIMER_CLK>;
        clock-names = "core",
                      "timer";

        interrupts = <GIC_SPI 477 IRQ_TYPE_EDGE_RISING>;

        operating-points-v2 = <&csiphy_opp_table>;

        power-domains = <&camcc CAM_CC_TITAN_TOP_GDSC>,
                        <&rpmhpd RPMHPD_MMCX>,
                        <&rpmhpd RPMHPD_MX>;
        power-domain-names = "top",
                             "mmcx",
                             "mx";

        vdda-0p8-supply = <&vreg_l2c_0p8>;
        vdda-1p2-supply = <&vreg_l1c_1p2>;

        ports {
            #address-cells = <1>;
            #size-cells = <0>;

            port@0 {
                reg = <0>;
                csiphy0_in_ep: endpoint {
                    data-lanes = <0 1>;
                    clock-lanes = <2>;
                    remote-endpoint = <&sensor_out>;
                };
            };

            port@2 {
                reg = <2>;
                csiphy0_out_ep: endpoint {
                    remote-endpoint = <&controller_in>;
                };
            };
        };
    };

    csiphy_opp_table: opp-table {
        compatible = "operating-points-v2";

        opp-300000000 {
            opp-hz = /bits/ 64 <300000000>;
            required-opps = <&rpmhpd_opp_low_svs_d1>,
                            <&rpmhpd_opp_low_svs_d1>;
        };
    };
```

## drivers/media/platform/qcom/camss/Kconfig
```kconfig
config VIDEO_QCOM_CAMSS
	tristate "Qualcomm V4L2 Camera Subsystem driver"
	depends on V4L_PLATFORM_DRIVERS
	depends on VIDEO_DEV
	depends on (ARCH_QCOM && IOMMU_DMA) || COMPILE_TEST
	select MEDIA_CONTROLLER
	select VIDEO_V4L2_SUBDEV_API
	select VIDEOBUF2_DMA_SG
	select V4L2_FWNODE
	select PHY_QCOM_MIPI_CSI2

config VIDEO_QCOM_CAMSS_HARD_ISP
	tristate "Qualcomm CAMSS Hardware ISP (ICP/IPE/BPS)"
	depends on VIDEO_QCOM_CAMSS
	depends on QCOM_MDT_LOADER
	depends on QCOM_SCM
	depends on VIDEO_DEV
	select VIDEOBUF2_DMA_CONTIG
	select V4L2_MEM2MEM_DEV
	help
	  Enable support for the hardware ISP found in Qualcomm camera
	  subsystems on SoCs like X1E80100. This includes:

	  - ICP (Image Control Processor): Tensilica LX7 that runs
	    camera firmware and provides HFI interface
	  - IPE (Image Processing Engine): V4L2 m2m device for noise
	    reduction, sharpening, and scaling
	  - BPS (Bayer Processing Segment): V4L2 m2m device for
	    demosaicing raw Bayer data

	  If unsure, say N.

	  To compile this as modules, choose M here. The modules will
	  be called camss-icp, camss-ipe, and camss-bps, respecitvely.
```
